/* Customize nice!view status screen: disable WPM graph and enable lock indicators */

&wpm_graph {
    status = "disabled";
};

&lock_status {
    status = "okay";
};

/* Nyan widget node is supplied from keymap overlay to avoid duplication */
