## Kconfig
```kconfig
menu "ZMK Nyan Widget"

config ZMK_WIDGET_NYAN
    bool "Enable animated Nyan widget"
    default y
    help
      Adds an animated Nyan Cat widget to the status screen.

endmenu

menu "Corne Custom Features"

config CORNE_LAYER_BLE_SERVICE
    bool "Expose active layer over a custom BLE GATT service"
    default y
    help
      Publishes the highest active layer name through a custom BLE
      characteristic that supports read and notify.

endmenu
```

## dts/bindings/zmk,widget-nyan.yaml
```yaml
# SPDX-License-Identifier: MIT

title: ZMK Animated Nyan Widget

description: |
  Animated Nyan Cat widget for ZMK status screen. Cycles frames and
  stops after a configurable timeout.

compatible: "zmk,widget-nyan"

properties:
  x:
    type: int
    required: false
    description: X position in pixels on the screen
    default: 80

  y:
    type: int
    required: false
    description: Y position in pixels on the screen
    default: 0

  frame-delay-ms:
    type: int
    required: false
    description: Frame interval in milliseconds
    default: 100

  timeout-ms:
    type: int
    required: false
    description: Auto-stop animation timeout in milliseconds
    default: 10000
```
